#include "ModbusCRC.h"


const uint16_t crc16_table[256] = {
0x0000, 0xC0C1, 0xC181, 0x0140, 0xC301, 0x03C0, 0x0280, 0xC241,0xC601, 0x06C0,

0x0780, 0xC741, 0x0500, 0xC5C1, 0xC481, 0x0440,0xCC01, 0x0CC0, 0x0D80, 0xCD41,
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0x4380, 0x8341, 0x4100, 0x81C1, 0x8081, 0x4040
};


const unsigned char CRCHi_table[ ]  =  {    //CRC高位字节值表
0x00, 0xC1, 0x81, 0x40, 0x01, 0xC0, 0x80, 0x41, 0x01, 0xC0,

0x80, 0x41, 0x00, 0xC1, 0x81, 0x40, 0x01, 0xC0, 0x80, 0x41,
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0x80, 0x41,0x00, 0xC1, 0x81, 0x40
};

const unsigned char CRCLo_table[ ] = {    //CRC低位字节值表
0x00, 0xC0, 0xC1, 0x01, 0xC3, 0x03, 0x02, 0xC2, 0xC6, 0x06,

0x07, 0xC7,0x05, 0xC5, 0xC4, 0x04, 0xCC, 0x0C, 0x0D, 0xCD,
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0x43, 0x83, 0x41, 0x81, 0x80, 0x40
};


// 计算CRC-16-Modbus，输入：待计算数据的首指针和长度
// 返回：16位CRC值（原始结果，尚未交换字节顺序）
unsigned short ModbusCRC(const unsigned char *data, unsigned short len)
{
    unsigned short crc = 0xFFFF;
    unsigned short i;
    unsigned char index;

    for(i = 0; i < len; i++)
    {
        index = (unsigned char)(crc ^ data[i]);
        crc = (crc >> 8) ^ ( (CRCHi_table[index] << 8) | CRCLo_table[index] );
    }
    return crc;
}


unsigned char ascii_to_byte(unsigned char high, unsigned char low)
{
    unsigned char nibble_h, nibble_l;
    // 十六进制字符转半字节
    if(high >= '0' && high <= '9') nibble_h = high - '0';
    else if(high >= 'A' && high <= 'F') nibble_h = high - 'A' + 10;
    else if(high >= 'a' && high <= 'f') nibble_h = high - 'a' + 10;
    else nibble_h = 0; // 非法字符

    if(low >= '0' && low <= '9') nibble_l = low - '0';
    else if(low >= 'A' && low <= 'F') nibble_l = low - 'A' + 10;
    else if(low >= 'a' && low <= 'f') nibble_l = low - 'a' + 10;
    else nibble_l = 0;

    return (nibble_h << 4) | nibble_l;
}
/*
 * 从环形缓冲区中读取 ASCII 字符并尝试解析一帧。
 * 返回值:
 *   1  – 成功解析一帧，结果存入 frame
 *  -1  – CRC 校验失败
 *   0  – 数据不足，需要继续接收
 */
int parse_ascii_frame_from_rb(RingBuffer *rb, ParsedFrame *frame) {
    // 状态机内部状态（保持跨调用）
    static int state = 0;          // 0:找帧头, 1:收数据
    static int bin_len = 0;        // 已收二进制字节数
    static unsigned char bin_buf[256]; // 二进制临时缓冲区
    static int ascii_wait = 0;     // 0:待高半字节, 1:待低半字节
    static unsigned char high_nibble; // 暂存高半字节

    unsigned char ch;
    // 循环读取环缓冲区中的 ASCII 字符
    while (RingBuffer_Read(rb, &ch, 1) == 1) {
        // 仅处理十六进制字符（0-9 A-F a-f）
        if (!((ch >= '0' && ch <= '9') ||
              (ch >= 'A' && ch <= 'F') ||
              (ch >= 'a' && ch <= 'f')))
            continue;

        // ---- 将 ASCII 对转换成二进制字节 ----
        unsigned char nibble;
        if (ch >= '0' && ch <= '9')      nibble = ch - '0';
        else if (ch >= 'A' && ch <= 'F') nibble = ch - 'A' + 10;
        else                             nibble = ch - 'a' + 10;

        if (ascii_wait == 0) {
            high_nibble = nibble;
            ascii_wait = 1;
            continue;
        } else {
            unsigned char byte = (high_nibble << 4) | nibble;
            ascii_wait = 0;

            // ---- 状态机处理该字节 ----
            if (state == 0) { // 寻找帧头 A5B6
                if (bin_len == 0 && byte == 0xA5) {
                    bin_buf[0] = 0xA5;
                    bin_len = 1;
                } else if (bin_len == 1 && byte == 0xB6) {
                    bin_buf[1] = 0xB6;
                    bin_len = 2;
                    state = 1; // 进入帧体收集
                } else {
                    bin_len = 0; // 重置找帧头
                }
            } else {          // 收集帧体（state == 1）
                bin_buf[bin_len++] = byte;

                // 是否已经有足够的信息判断完整帧长度？
                if (bin_len >= 9) {
                    unsigned char content_len = bin_buf[7]; // 索引 7 = 报文长度
                    unsigned short total_len = 9 + content_len + 4; // 帧头9 + 内容 + CRC2 + 结束2

                    if (bin_len == total_len) {
                        // 检查结束标志
                        if (bin_buf[total_len-2] == 0xB6 &&
                            bin_buf[total_len-1] == 0xA5) {

                            // CRC 校验
                            unsigned short calc_crc = ModbusCRC(bin_buf, 9 + content_len);
                            unsigned short recv_crc = (bin_buf[total_len-4] << 8) |
                                                       bin_buf[total_len-3];
                            if (calc_crc == recv_crc) {
                                // 成功解析
                                frame->dev_id      = (bin_buf[2] << 8) | bin_buf[3];
                                frame->frame_type  = bin_buf[4];
                                frame->cmd_word    = (bin_buf[5] << 8) | bin_buf[6];
                                frame->version     = bin_buf[8];
                                frame->content_len = content_len;
                                for (int i = 0; i < content_len; i++)
                                    frame->content[i] = bin_buf[9 + i];

                                // 重置状态机，返回成功
                                state = 0; bin_len = 0; ascii_wait = 0;
                                return 1;
                            } else {
                                // CRC 错误
                                state = 0; bin_len = 0; ascii_wait = 0;
                                return -1;
                            }
                        } else {
                            // 结束标志错误，丢弃
                            state = 0; bin_len = 0; ascii_wait = 0;
                            // 可返回 -1 或 0，这里返回 0 继续等待后续数据
                            return 0;
                        }
                    }
                }
            }
        }
    }
    return 0; // 环形缓冲区中没有足够数据
}


// 发送一个应答帧
// 参数：dev_id 本机ID, frame_type 0x02或0xFF, cmd_word 命令字,
//       content 内容首指针, content_len 内容长度
void send_response(unsigned short dev_id, unsigned char frame_type,
                   unsigned short cmd_word,
                   unsigned char *content, unsigned char content_len)
{
    unsigned char frame_bin[256];
    int idx = 0;

    // 起始标志 0xA5B6
    frame_bin[idx++] = 0xA5;
    frame_bin[idx++] = 0xB6;
    // 设备ID
    frame_bin[idx++] = (unsigned char)(dev_id >> 8);
    frame_bin[idx++] = (unsigned char)(dev_id & 0xFF);
    // 帧类型
    frame_bin[idx++] = frame_type;
    // 命令字
    frame_bin[idx++] = (unsigned char)(cmd_word >> 8);
    frame_bin[idx++] = (unsigned char)(cmd_word & 0xFF);
    // 报文长度
    frame_bin[idx++] = content_len;
    // 协议版本 固定0x02
    frame_bin[idx++] = 0x02;
    // 内容
    for(int i=0; i<content_len; i++)
        frame_bin[idx++] = content[i];

    // 计算CRC（从起始标志到内容末尾，共idx个字节）
    unsigned short crc_val = ModbusCRC(frame_bin, idx);
    // 大端序填入CRC
    frame_bin[idx++] = (unsigned char)(crc_val >> 8);
    frame_bin[idx++] = (unsigned char)(crc_val & 0xFF);
    // 结束标志
    frame_bin[idx++] = 0xB6;
    frame_bin[idx++] = 0xA5;

    // 现在frame_bin是完整的二进制帧，共idx字节
    // 将每个字节转换为两个ASCII字符，并通过串口发送
    for(int i=0; i<idx; i++)
    {
        unsigned char byte = frame_bin[i];
        unsigned char high_nibble = (byte >> 4) & 0x0F;
        unsigned char low_nibble  = byte & 0x0F;
        // 半字节转ASCII
        char high_char = (high_nibble < 10) ? ('0' + high_nibble) : ('A' + high_nibble - 10);
        char low_char  = (low_nibble  < 10) ? ('0' + low_nibble)  : ('A' + low_nibble  - 10);
        uint8_t temp1[1]={high_char};
				uint8_t temp2[1]={low_char};
			// 写串口发送（使用你的串口发送函数）
        usart_485_send_str(temp1,1);usart_485_send_str(temp2,1);
    }
}

